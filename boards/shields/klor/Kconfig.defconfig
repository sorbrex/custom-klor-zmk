## boards/shields/klor/Kconfig.defconfig
```kconfig
if SHIELD_KLOR_LEFT || SHIELD_KLOR_RIGHT

  config ZMK_SPLIT
    default y


  if ZMK_DISPLAY

      config I2C
          default y

      config SSD1306
          default y

  endif # ZMK_DISPLAY


  if LVGL

      config LV_Z_VDB_SIZE
          default 64

      config LV_DPI_DEF
          default 148

      config LV_Z_BITS_PER_PIXEL
          default 1

      choice LV_COLOR_DEPTH
          default LV_COLOR_DEPTH_1
      endchoice

  endif # LVGL

endif # LEFT RIGHT

if SHIELD_KLOR_DONGLE

  config ZMK_KEYBOARD_NAME
      default "Klorius"

  config ZMK_SPLIT_ROLE_CENTRAL
      default y

  config ZMK_SPLIT
      default y

  config ZMK_SPLIT_BLE_CENTRAL_PERIPHERALS
      default 2

  config BT_MAX_CONN
      default 6

  config BT_MAX_PAIRED
      default 6

  if ZMK_STUDIO

    config USB_DEVICE_STACK
        default y

    config USB_DEVICE_HID
        default y

    config ZMK_STUDIO_LOCKING
        default n

  endif # ZMK_STUDIO
endif # SHIELD_KLOR_DONGLE
```

## boards/shields/klor/Kconfig.shield
```kconfig
config SHIELD_KLOR_LEFT
    def_bool $(shields_list_contains,klor_left)

config SHIELD_KLOR_RIGHT
    def_bool $(shields_list_contains,klor_right)

config SHIELD_KLOR_DONGLE
    def_bool $(shields_list_contains,klor_dongle)
```

## config/boards/shields/klor/Kconfig.defconfig
```kconfig
if SHIELD_KLOR_LEFT

    config ZMK_KEYBOARD_NAME
        default "KLOR"

    config ZMK_SPLIT_BLE_ROLE_CENTRAL
        default y

endif # LEFT



if SHIELD_KLOR_LEFT || SHIELD_KLOR_RIGHT

    config ZMK_SPLIT
        default y


if ZMK_DISPLAY

    config I2C
        default y

    config SSD1306
        default y

endif # ZMK_DISPLAY



if LVGL

    config LV_Z_VDB_SIZE
        default 64

    config LV_DPI_DEF
        default 148

    config LV_Z_BITS_PER_PIXEL
        default 1

    choice LV_COLOR_DEPTH
        default LV_COLOR_DEPTH_1
    endchoice

endif # LVGL


endif # LEFT RIGHT

if SHIELD_KLOR_DONGLE

# Max 16 characters in keyboard name
config ZMK_KEYBOARD_NAME
    default "Kloribus"

config ZMK_SPLIT_ROLE_CENTRAL
    default y

config ZMK_SPLIT
    default y

# Set this to the number of peripherals your dongle will have.
# For a unibody, this would be 1. If you have left and right halves, set it to 2, etc.
config ZMK_SPLIT_BLE_CENTRAL_PERIPHERALS
    default 2

# Set this to ZMK_SPLIT_BLE_CENTRAL_PERIPHERALS + your desired number of BT profiles (default is 5)
config BT_MAX_CONN
    default 6

# Set this to the same number as BT_MAX_CONN
config BT_MAX_PAIRED
    default 6
if ZMK_STUDIO

config USB_DEVICE_STACK
    default y

config USB_DEVICE_HID
    default y
    
config ZMK_STUDIO_LOCKING
    default n

endif
endif
```

## config/west.yml
```yaml
manifest:
  remotes:
    - name: zmkfirmware
      url-base: https://github.com/zmkfirmware
#    - name: englmaxi
#      url-base: https://github.com/englmaxi
    - name: janpfischer
      url-base: https://github.com/janpfischer
  projects:
    - name: zmk
      remote: zmkfirmware
      revision: main
      import: app/west.yml
    - name: zmk-dongle-screen
      remote: janpfischer
      revision: main
#    - name: zmk-dongle-display
#      remote: englmaxi
#      revision: main
  self:
    path: config
```
